## drivers/nubia/fingerprint/Kconfig
```kconfig
################################################# FINGER_PRINTER START
config  NUBIA_SENSORS_FP
	tristate "NUBIA FP DEVICE"
	default y

if NUBIA_SENSORS_FP
source drivers/nubia/fingerprint/gf3266/Kconfig
source drivers/nubia/fingerprint/silead/Kconfig

endif
```
